#include "Arduino.h"
#include "Adafruit_GFX.h"

// Public-domain 5x7 font, ' ' (0x20) .. '~' (0x7E). One byte per column,
// least significant bit at the top.
static const uint8_t kFont5x7[95][5] = {
    {0x00, 0x00, 0x00, 0x00, 0x00}, {0x00, 0x00, 0x5F, 0x00, 0x00}, {0x00, 0x07, 0x00, 0x07, 0x00}, {0x14, 0x7F, 0x14, 0x7F, 0x14},
    {0x24, 0x2A, 0x7F, 0x2A, 0x12}, {0x23, 0x13, 0x08, 0x64, 0x62}, {0x36, 0x49, 0x55, 0x22, 0x50}, {0x00, 0x05, 0x03, 0x00, 0x00},
    {0x00, 0x1C, 0x22, 0x41, 0x00}, {0x00, 0x41, 0x22, 0x1C, 0x00}, {0x08, 0x2A, 0x1C, 0x2A, 0x08}, {0x08, 0x08, 0x3E, 0x08, 0x08},
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    {0x00, 0x00, 0x7F, 0x00, 0x00}, {0x00, 0x41, 0x36, 0x08, 0x00}, {0x02, 0x01, 0x02, 0x04, 0x02},
};

Adafruit_GFX::Adafruit_GFX(int16_t w, int16_t h) : WIDTH(w), HEIGHT(h), _width(w), _height(h) {}

void Adafruit_GFX::setRotation(uint8_t r) {
    rotation = r & 3;
    _width = (rotation & 1) ? HEIGHT : WIDTH;
    _height = (rotation & 1) ? WIDTH : HEIGHT;
}

void Adafruit_GFX::writeFillRect(int16_t x, int16_t y, int16_t w, int16_t h, uint16_t color) {
    for (int16_t i = x; i < x + w; i++)
        for (int16_t j = y; j < y + h; j++) writePixel(i, j, color);
}

void Adafruit_GFX::writeLine(int16_t x0, int16_t y0, int16_t x1, int16_t y1, uint16_t color) {
    const bool steep = abs(y1 - y0) > abs(x1 - x0);
    if (steep) { int16_t t = x0; x0 = y0; y0 = t; t = x1; x1 = y1; y1 = t; }
    if (x0 > x1) { int16_t t = x0; x0 = x1; x1 = t; t = y0; y0 = y1; y1 = t; }
    const int16_t dx = x1 - x0, dy = abs(y1 - y0), ystep = y0 < y1 ? 1 : -1;
    int16_t err = dx / 2;
    for (; x0 <= x1; x0++) {
        if (steep) writePixel(y0, x0, color);
        else writePixel(x0, y0, color);
        err -= dy;
        if (err < 0) { y0 += ystep; err += dx; }
    }
}

void Adafruit_GFX::drawFastVLine(int16_t x, int16_t y, int16_t h, uint16_t color) {
    startWrite(); writeFastVLine(x, y, h, color); endWrite();
}

void Adafruit_GFX::drawFastHLine(int16_t x, int16_t y, int16_t w, uint16_t color) {
    startWrite(); writeFastHLine(x, y, w, color); endWrite();
}

void Adafruit_GFX::fillRect(int16_t x, int16_t y, int16_t w, int16_t h, uint16_t color) {
    startWrite(); writeFillRect(x, y, w, h, color); endWrite();
}

void Adafruit_GFX::fillScreen(uint16_t color) {
    fillRect(0, 0, _width, _height, color);
}

void Adafruit_GFX::drawLine(int16_t x0, int16_t y0, int16_t x1, int16_t y1, uint16_t color) {
    if (x0 == x1) { if (y0 > y1) { int16_t t = y0; y0 = y1; y1 = t; } drawFastVLine(x0, y0, y1 - y0 + 1, color); }
    else if (y0 == y1) { if (x0 > x1) { int16_t t = x0; x0 = x1; x1 = t; } drawFastHLine(x0, y0, x1 - x0 + 1, color); }
    else { startWrite(); writeLine(x0, y0, x1, y1, color); endWrite(); }
}

void Adafruit_GFX::drawRect(int16_t x, int16_t y, int16_t w, int16_t h, uint16_t color) {
    startWrite();
    writeFastHLine(x, y, w, color);
    writeFastHLine(x, y + h - 1, w, color);
    writeFastVLine(x, y, h, color);
    writeFastVLine(x + w - 1, y, h, color);
    endWrite();
}

void Adafruit_GFX::drawCircle(int16_t x0, int16_t y0, int16_t r, uint16_t color) {
    int16_t f = 1 - r, ddF_x = 1, ddF_y = -2 * r, x = 0, y = r;
    startWrite();
    writePixel(x0, y0 + r, color); writePixel(x0, y0 - r, color);
    writePixel(x0 + r, y0, color); writePixel(x0 - r, y0, color);
    while (x < y) {
        if (f >= 0) { y--; ddF_y += 2; f += ddF_y; }
        x++; ddF_x += 2; f += ddF_x;
        writePixel(x0 + x, y0 + y, color); writePixel(x0 - x, y0 + y, color);
        writePixel(x0 + x, y0 - y, color); writePixel(x0 - x, y0 - y, color);
        writePixel(x0 + y, y0 + x, color); writePixel(x0 - y, y0 + x, color);
        writePixel(x0 + y, y0 - x, color); writePixel(x0 - y, y0 - x, color);
    }
    endWrite();
}

void Adafruit_GFX::fillCircle(int16_t x0, int16_t y0, int16_t r, uint16_t color) {
    startWrite();
    writeFastVLine(x0, y0 - r, 2 * r + 1, color);
    int16_t f = 1 - r, ddF_x = 1, ddF_y = -2 * r, x = 0, y = r;
    while (x < y) {
        if (f >= 0) { y--; ddF_y += 2; f += ddF_y; }
        x++; ddF_x += 2; f += ddF_x;
        writeFastVLine(x0 + x, y0 - y, 2 * y + 1, color); writeFastVLine(x0 - x, y0 - y, 2 * y + 1, color);
        writeFastVLine(x0 + y, y0 - x, 2 * x + 1, color); writeFastVLine(x0 - y, y0 - x, 2 * x + 1, color);
    }
    endWrite();
}

void Adafruit_GFX::drawTriangle(int16_t x0, int16_t y0, int16_t x1, int16_t y1, int16_t x2, int16_t y2, uint16_t color) {
    drawLine(x0, y0, x1, y1, color);
    drawLine(x1, y1, x2, y2, color);
    drawLine(x2, y2, x0, y0, color);
}

void Adafruit_GFX::drawRGBBitmap(int16_t x, int16_t y, const uint16_t bitmap[], int16_t w, int16_t h) {
    startWrite();
    for (int16_t j = 0; j < h; j++)
        for (int16_t i = 0; i < w; i++) writePixel(x + i, y + j, bitmap[j * w + i]);
    endWrite();
}

void Adafruit_GFX::drawGrayscaleBitmap(int16_t x, int16_t y, const uint8_t bitmap[], int16_t w, int16_t h) {
    startWrite();
    for (int16_t j = 0; j < h; j++)
        for (int16_t i = 0; i < w; i++) {
            const uint8_t v = bitmap[j * w + i];
            writePixel(x + i, y + j, uint16_t(((v & 0xF8) << 8) | ((v & 0xFC) << 3) | (v >> 3)));
        }
    endWrite();
}

void Adafruit_GFX::drawChar(int16_t x, int16_t y, unsigned char c, uint16_t color, uint16_t bg, uint8_t size) {
    if (x >= _width || y >= _height || x + 6 * size - 1 < 0 || y + 8 * size - 1 < 0) return;
    if (c < 0x20 || c > 0x7E) c = '?';
    const uint8_t* glyph = kFont5x7[c - 0x20];
    startWrite();
    for (int8_t i = 0; i < 6; i++) {
        uint8_t line = i < 5 ? glyph[i] : 0;   // 6th column: spacing
        for (int8_t j = 0; j < 8; j++, line >>= 1) {
            const bool on = line & 1;
            if (!on && bg == color) continue;   // transparent background
            const uint16_t col = on ? color : bg;
            if (size == 1) writePixel(x + i, y + j, col);
            else writeFillRect(x + i * size, y + j * size, size, size, col);
        }
    }
    endWrite();
}

size_t Adafruit_GFX::write(uint8_t c) {
    if (c == '\n') { cursor_x = 0; cursor_y += int16_t(textsize) * 8; return 1; }
    if (c == '\r') return 1;
    if (wrap && cursor_x + textsize * 6 > _width) { cursor_x = 0; cursor_y += int16_t(textsize) * 8; }
    drawChar(cursor_x, cursor_y, c, textcolor, textbgcolor, textsize);
    cursor_x += int16_t(textsize) * 6;
    return 1;
}
